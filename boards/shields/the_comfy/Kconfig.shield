## boards/shields/the_comfy/Kconfig.shield
```kconfig
config SHIELD_the_comfy_DONGLE
    def_bool $(shields_list_contains,the_comfy_dongle)

config SHIELD_the_comfy_LEFT
    def_bool $(shields_list_contains,the_comfy_left)

config SHIELD_the_comfy_RIGHT
    def_bool $(shields_list_contains,the_comfy_right)
```
